## boards/shields/roBa/drivers/Kconfig
```kconfig
# PMW3610 Driver Configuration for ZMK

menuconfig ZMK_INPUT_PMW3610
    bool "PMW3610 mouse optical sensor"
    default y
    depends on DT_HAS_PIXART_PMW3610_ENABLED || DT_HAS_PIXART_PMW3610_ALT_ENABLED
    select SPI
    help
      Enable PMW3610 mouse optical sensor for ZMK.

if ZMK_INPUT_PMW3610

config ZMK_INPUT_PMW3610_CPI
    int "CPI"
    default 400

config ZMK_INPUT_PMW3610_CPI_DIVIDER
    int "CPI Divider"
    default 1

config ZMK_INPUT_PMW3610_ORIENTATION_180
    bool "Rotate 180 degrees"
    default n

config ZMK_INPUT_PMW3610_INVERT_X
    bool "Invert X"
    default n

config ZMK_INPUT_PMW3610_INVERT_Y
    bool "Invert Y"
    default n

config ZMK_INPUT_PMW3610_INVERT_SCROLL_X
    bool "Invert Scroll X"
    default n

config ZMK_INPUT_PMW3610_INVERT_SCROLL_Y
    bool "Invert Scroll Y"
    default n

config ZMK_INPUT_PMW3610_SCROLL_TICK
    int "Scroll Tick"
    default 16

config ZMK_INPUT_PMW3610_RUN_DOWNSHIFT_TIME_MS
    int "Run Downshift Time"
    default 3264

config ZMK_INPUT_PMW3610_REST1_SAMPLE_TIME_MS
    int "Rest 1 Sample Time"
    default 20

config ZMK_INPUT_PMW3610_POLLING_RATE_125_SW
    bool "Software Polling 125Hz"
    default n

config ZMK_INPUT_PMW3610_AUTOMOUSE_TIMEOUT_MS
    int "Auto-mouse Timeout"
    default 700

config ZMK_INPUT_PMW3610_MOVEMENT_THRESHOLD
    int "Movement Threshold"
    default 0

config ZMK_INPUT_PMW3610_SMART_ALGORITHM
    bool "Enable Smart Algorithm"
    default y

endif
```

## config/west.yml
```yaml
manifest:
  remotes:
    - name: zmkfirmware
      url-base: https://github.com/zmkfirmware
    - name: urob
      url-base: https://github.com/urob
  projects:
    - name: zmk
      remote: zmkfirmware
      revision: main
      import: app/west.yml
    # 'name' を適当な名前にし、'repo-path' で実際のリポジトリを指定します
    - name: pmw3610_driver_fresh
      remote: urob
      repo-path: zmk-pmw3610-driver
      revision: main
  self:
    path: config
```
